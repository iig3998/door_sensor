## main/Kconfig
```kconfig
menu "Door sensor"

config WIFI_SSID
    string "Set Access Point"
    default "ESP32"

config WIFI_PASSWORD
    string "Password"
    default "012345678"

config NUMBER_ATTEMPTS
    int "Set retrasmission number"
    default 3
    range 0 10

config ESPNOW_WIFI_CHANNEL
    int "Set WiFi channel for espnow protocol"
    default 7
    range 1 10

config RETRASMISSION_TIME_MS
    int "Set retrasmission time in milliseconds"
    default 50
    range 5 100

endmenu
```
